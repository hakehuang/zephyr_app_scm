## boards/records_new/boards/arm/kw45b41z_evk/Kconfig.defconfig
```kconfig
# KW45B41Z-EVK board

# Copyright 2023 NXP
# SPDX-License-Identifier: Apache-2.0

if BOARD_KW45B41Z_EVK

config BOARD
	default "kw45b41z_evk"

endif # BOARD_KW45B41Z_EVK
```

## boards/records_new/boards/arm/rdrw612bga_evk/Kconfig.board
```kconfig
# Copyright (c) 2022, NXP
# SPDX-License-Identifier: Apache-2.0

config BOARD_RDRW612BGA_EVK
	bool "NXP RW612BGA-EVK"
	depends on SOC_SERIES_RW6XX
	select SOC_PART_NUMBER_RW612ETA1I
	select NXP_RW6XX_BOOT_HEADER if !BOOTLOADER_MCUBOOT
```
